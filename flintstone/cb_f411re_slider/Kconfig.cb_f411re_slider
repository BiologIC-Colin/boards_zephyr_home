## flintstone/cb_f411re_slider/Kconfig.cb_f411re_slider
```kconfig
# C Barker Camer Slider v1.0

config BOARD_CB_F411RE_SLIDER
    select SOC_STM32F411XE
```

## flintstone/cb_f411re_slider/board.yml
```yaml
board:
  name: cb_f411re_slider
  full_name: Camera Slider V1
  vendor: flintstone
  socs:
    - name: stm32f411xe
```

## flintstone/cb_s3_slider/board.yml
```yaml
board:
  name: cb_s3_slider
  full_name: Camera Slider V1 (ESP32-S3 side)
  vendor: flintstone
  socs:
    - name: esp32s3
```
